/*
  SSD1306_SWI2C.cpp - Display driver for SSD1306 display, icnludes TWI & Display Buffer
  Copyright 2018, SytheZN, All rights reserved.
*/
#include "Arduino.h"
#include "SSD1306_SWI2C.h"
#include "Wire.h"

int _sda;
int _scl;

SSD1306::SSD1306(int sda, int scl)
{
  _sda = sda;
  _scl = scl;
  twi_init();
  display_init();
  blank();
  refresh();
}

static byte buf[32][16] = {
    {0x00, 0x00, 0x00, 0x00, 0x00, 0x00, 0x00, 0x00, 0x00, 0x00, 0x00, 0x00, 0x00, 0x00, 0x00, 0x00},
    {0x00, 0x00, 0x00, 0x00, 0x00, 0x1F, 0xE0, 0x00, 0x00, 0x00, 0x00, 0x00, 0x00, 0x00, 0x00, 0x00},
    {0x00, 0x00, 0x00, 0x00, 0x00, 0x7F, 0xF8, 0x00, 0x00, 0x00, 0x00, 0x00, 0x00, 0x00, 0x00, 0x00},
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    {0x00, 0x00, 0x00, 0x00, 0x00, 0x00, 0x00, 0x00, 0x00, 0x00, 0x00, 0x00, 0x00, 0x00, 0x00, 0x00}};

void SSD1306::display_init()
{
  twi_start();

  twi_send(CB_CTRL);
  twi_send(CMD_DISP_OFF);

  twi_send(CB_CTRL);
  twi_send(CMD_CHARGE_PUMP);
  twi_send(DATA_CHARGE_PUMP_ON);

  twi_send(CB_CTRL);
  twi_send(CMD_DISP_ON);

  twi_send(CB_CTRL);
  twi_send(CMD_CONTRAST);
  twi_send(0x00);

  twi_send(CB_CTRL);
  twi_send(CMD_ADDRMODE);
  twi_send(CMD_ADDRMODE_V);

  twi_send(CB_CTRL);
  twi_send(CMD_ADDR_HVCOL);
  twi_send(0x00); //start address
  twi_send(0x7F); //stop address

  twi_send(CB_CTRL);
  twi_send(CMD_ADDR_HVPAGE);
  twi_send(0x00); //start page
  twi_send(0x07); //stop page

  twi_stop();
}

void SSD1306::set_pixel(const uint8_t x, const uint8_t y, const bool state)
{
  const auto xb = x / 8, xbn = 7 - (x % 8);
  if (xb >= 16 || y >= 32)
    return;

  if (state)
  {
    buf[y][xb] |= (0x01 << xbn);
  }
  else
  {
    buf[y][xb] &= ~(0x01 << xbn);
  }
}

void SSD1306::blank()
{
  twi_start();
  twi_send(CB_DATA);
  for (int i = 0; i < 1024; i++)
  {
    twi_send(0x80);
  }
  twi_stop();
}

void SSD1306::clear_buffer()
{
  for (uint8_t y = 0; y < 32; y++)
  {
    for (uint8_t x = 0; x < 16; x++)
    {
      buf[y][x] = 0x00;
    }
  }
}

void SSD1306::refresh()
{
  twi_start();
  twi_send(CB_DATA);
  for (uint8_t x = 0; x < 128; x++)
  {
    uint8_t xb = x / 8, xbn = 7 - (x % 8);
    for (uint8_t y = 0; y < 32; y += 4)
    {
      twi_send(0b10101010 | (1 & (buf[y][xb] >> xbn)) | (1 & (buf[y + 1][xb] >> xbn)) << 2 | (1 & (buf[y + 2][xb] >> xbn)) << 4 | (1 & (buf[y + 3][xb] >> xbn)) << 6);
    }
  }
  twi_stop();
}

void SSD1306::reinitialise()
{
  display_init();
}

void SSD1306::display_off()
{
  twi_start();
  twi_send(CB_CTRL);
  twi_send(CMD_DISP_OFF);
  twi_stop();
}

void SSD1306::twi_init()
{
  Wire.begin(_sda, _scl);
  Wire.setClock(400000);
}

int sendcount = 0;
void SSD1306::twi_start()
{
  Wire.beginTransmission(ADDR_W);
  sendcount = 0;
}

void SSD1306::twi_stop()
{
  Wire.endTransmission();
}

void SSD1306::twi_send(byte val)
{
  Wire.write(val);
  sendcount++;

  if (sendcount == 128)
  {
    twi_stop();
    twi_start();
    twi_send(CB_DATA);
  }
}
